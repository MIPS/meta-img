## conf/bblayers.conf.sample
```bitbake
POKY_BBLAYERS_CONF_VERSION = "2"
BBPATH = "${TOPDIR}"
BBFILES ?= ""
BBLAYERS ?= " \
  ##COREBASE##/meta \
  ##COREBASE##/meta-poky \
  ##COREBASE##/meta-yocto-bsp \
  ##COREBASE##/meta-img \
  "
```

## conf/layer.conf
```bitbake
# We have a conf and classes directory, add to BBPATH
BBPATH .= ":${LAYERDIR}"

# We have a recipes-* directories, add to BBFILES
BBFILES += "${LAYERDIR}/recipes-*/*/*.bb \
	${LAYERDIR}/recipes-*/*/*.bbappend"

BBFILE_COLLECTIONS += "img"
BBFILE_PATTERN_img = "^${LAYERDIR}/"
BBFILE_PRIORITY_img = "6"
```

## conf/machine/ci40.conf
```bitbake
#@TYPE: Machine
#@NAME: ci40
#@DESCRIPTION: Imagination Technologies Creator Ci40 platform
#For more detail check out http://creatordev.io/ci40-iot-hub

require conf/machine/include/tune-mips32r2.inc

DEFAULTTUNE = "mips32r2el"
MACHINE_FEATURES = "serial"
SERIAL_CONSOLES = "115200;ttyS1"
IMAGE_FSTYPES ?= "tar.gz"

PREFERRED_PROVIDER_virtual/kernel = "linux-yocto-ci40"
KERNEL_IMAGETYPE = "uImage.bin"

PREFERRED_PROVIDER_u-boot = "u-boot_ci40.bb"

IMAGE_BOOT_FILES = "u-boot.img"

# Tune the ccargs for the interAptiv on the Ci40
TUNE_CCARGS_remove = "-march=mips32r2"
TUNE_CCARGS .= " -march=interaptiv"
```

## conf/machine/mips-common.inc
```bitbake
# Include file for parameters common to many MIPS platforms

KERNEL_IMAGETYPE = "vmlinux"
KERNEL_ALT_IMAGETYPE = "vmlinux.bin"

SERIAL_CONSOLES = "115200;ttyS0 115200;ttyS1"

# This disables gobject-introspection which needs fixing for some
# targets. If you need to use that package, remove this line.
MACHINE_FEATURES_BACKFILL_CONSIDERED = "qemu-usermode"

PREFERRED_PROVIDER_virtual/kernel ?= "linux-yocto"

# Use GCC version 6
GCCVERSION = "6.%"

# Use qemu v2.9
PREFERRED_PROVIDER_qemu = "qemu_2.9.0"
```

## conf/machine/qemumips32r6.conf
```bitbake
#@TYPE: Machine
#@NAME: qemumips32r6
#@DESCRIPTION: MIPS 32r6, Big Endian, Hard Float

require conf/machine/include/qemu.inc
require conf/machine/include/tune-mips32r6.inc
require mips-common.inc

DEFAULTTUNE = "mipsisa32r6"
```

## conf/machine/qemumips64r2-nf-o32.conf
```bitbake
#@TYPE: Machine
#@NAME: qemumips64r2-nf-o32
#@DESCRIPTION: MIPS 64r2, Big Endian, Soft Float, o32

require conf/machine/include/qemu.inc
require conf/machine/include/tune-mips64r2.inc
require mips-common.inc

DEFAULTTUNE = "mips64r2-nf-o32"
```

## conf/machine/qemumips64r2-o32.conf
```bitbake
#@TYPE: Machine
#@NAME: qemumips64r2-o32
#@DESCRIPTION: MIPS 64r2, Big Endian, Hard Float, o32

require conf/machine/include/qemu.inc
require conf/machine/include/qemuboot-mips.inc
require conf/machine/include/tune-mips64r2.inc
require mips-common.inc

DEFAULTTUNE = "mips64r2-o32"

# runqemu extra options
QB_CPU = "-cpu MIPS64R2-generic"
```

## conf/machine/qemumips64r2el-nf-o32.conf
```bitbake
#@TYPE: Machine
#@NAME: qemumips64r2el-o32-nf
#@DESCRIPTION: MIPS 64r2, Little Endian, Soft Float, o32

require conf/machine/include/qemu.inc
require conf/machine/include/tune-mips64r2.inc
require mips-common.inc

DEFAULTTUNE = "mips64r2el-nf-o32"
```

## conf/machine/qemumips64r2el-o32.conf
```bitbake
#@TYPE: Machine
#@NAME: qemumips64r2el-o32
#@DESCRIPTION: MIPS 64r2, Little Endian, Hard Float, o32

require conf/machine/include/qemu.inc
require conf/machine/include/tune-mips64r2.inc
require mips-common.inc

DEFAULTTUNE = "mips64r2el-o32"
```

## conf/machine/qemumips64r6.conf
```bitbake
#@TYPE: Machine
#@NAME: qemumips64r6
#@DESCRIPTION: MIPS 64r6, Big Endian, Hard Float

require conf/machine/include/qemu.inc
require conf/machine/include/tune-mips64r6.inc
require mips-common.inc

DEFAULTTUNE = "mipsisa64r6"
PREFERRED_VERSION_linux-yocto ?= "4.8"
```

## conf/machine/qemumips64r6el-n32.conf
```bitbake
#@TYPE: Machine
#@NAME: qemumips64r6el
#@DESCRIPTION: MIPS 64r6, Little Endian, Hard Float

require conf/machine/include/qemu.inc
require conf/machine/include/qemuboot-mips.inc
require conf/machine/include/tune-mips64r6.inc
require mips-common.inc

DEFAULTTUNE = "mipsisa64r6el-n32"

# runqemu extra options
QB_CPU = "-cpu MIPS64R6-generic"
QB_SYSTEM_NAME = "qemu-system-mips64el"
```

## conf/machine/qemumips64r6el.conf
```bitbake
#@TYPE: Machine
#@NAME: qemumips64r6el
#@DESCRIPTION: MIPS 64r6, Little Endian, Hard Float

require conf/machine/include/qemu.inc
require conf/machine/include/tune-mips64r6.inc
require mips-common.inc

DEFAULTTUNE = "mipsisa64r6el"
```

## conf/machine/xilfpga.conf
```bitbake
#@TYPE: Machine
#@NAME: xilfpga
#@DESCRIPTION: MIPSfpga  Imagination University Program

require conf/machine/include/tune-mips32r2.inc

DEFAULTTUNE = "mips32r2el-nf"
MACHINE_FEATURES = "serial"
SERIAL_CONSOLES = "115200;ttyS0"
IMAGE_FSTYPES ?= "cpio.gz"

PREFERRED_PROVIDER_virtual/kernel = "linux-yocto"
PREFERRED_VERSION_linux-yocto = "4.8.12%"
MACHINE_DEVICETREE ?= "xilfpga/nexys4ddr.dts"
KERNEL_IMAGETYPE = "vmlinux"

INITRAMFS_IMAGE = "mipsfpga-soc-initramfs"
INITRAMFS_IMAGE_BUNDLE = "1"

# This device doesn't have an RTC
MACHINE_FEATURES_BACKFILL_CONSIDERED = "rtc"
```
